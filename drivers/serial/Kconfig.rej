## drivers/serial/Kconfig.rej
```kconfig
--- drivers/serial/Kconfig
+++ drivers/serial/Kconfig
@@ -1472,7 +1472,7 @@
 
 config SERIAL_SC26XX_CONSOLE
 	bool "Console on SC2681/SC2692 serial port"
-	depends on SERIAL_SC26XX
+	depends on SERIAL_SC26XX=y
 	select SERIAL_CORE_CONSOLE
 	help
 	  Support for Console on SC2681/SC2692 serial ports.
```
